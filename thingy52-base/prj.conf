## CMakeLists.txt
```
cmake_minimum_required(VERSION 3.20.0)
find_package(Zephyr REQUIRED HINTS $ENV{ZEPHYR_BASE})

project(thingy52-base)

target_sources(app PRIVATE src/main.c)
```

## prj.conf
```kconfig
#Enable logging module and use rtt as backend
#See https://developer.nordicsemi.com/nRF_Connect_SDK/doc/latest/nrf/test_and_optimize/logging.html#
#https://docs.zephyrproject.org/latest/samples/subsys/logging/logger/README.html
CONFIG_LOG=y
CONFIG_LOG_BACKEND_UART=n
CONFIG_LOG_BACKEND_RTT=y
```

## src/main.c
```c
#include <zephyr/kernel.h>
#include <zephyr/logging/log.h>
LOG_MODULE_REGISTER(main,LOG_LEVEL_DBG);
int main(void)
{
        while(1){
                LOG_INF("Hello world");
                k_msleep(1000);
        }
        
        return 0;
}
```
